## buildroot_build/rpi_build/Config.in
```kconfig
source "$BR2_EXTERNAL_rpi_build_PATH/package/rpi/Config.in"
source "$BR2_EXTERNAL_rpi_build_PATH/package/dev/Config.in"
```

## buildroot_build/rpi_build/package/dev/Config.in
```kconfig
config BR2_PACKAGE_DEV
	bool "dev"
	help
		Includes the device drivers for the module
```

## buildroot_build/rpi_build/package/rpi/Config.in
```kconfig
config BR2_PACKAGE_RPI
	bool "rpi"
	help
	  Includes the files to be loaded on the raspberry pi
```
